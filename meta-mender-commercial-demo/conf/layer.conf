## meta-mender-commercial-demo/conf/layer.conf
```bitbake
# We have a conf and classes directory, add to BBPATH
BBPATH .= ":${LAYERDIR}"

# We have recipes-* directories, add to BBFILES
BBFILES += "${LAYERDIR}/recipes-*/*/*.bb \
            ${LAYERDIR}/recipes-*/*/*.bbappend"

BBFILE_COLLECTIONS += "meta-mender-commercial-demo"
BBFILE_PATTERN_meta-mender-commercial-demo = "^${LAYERDIR}/"
BBFILE_PRIORITY_meta-mender-commercial-demo = "6"

LAYERDEPENDS_meta-mender-commercial-demo = "core mender-demo mender-commercial"
LAYERSERIES_COMPAT_meta-mender-commercial-demo = "dunfell"
```
